## drivers/idle/Kconfig
```kconfig
config INTEL_IDLE
	bool "Cpuidle Driver for Intel Processors"
	depends on CPU_IDLE
	depends on X86
	depends on CPU_SUP_INTEL
	depends on INTEL_PMC_IPC=n || INTEL_PMC_IPC=y
	depends on INTEL_TELEMETRY=n || INTEL_TELEMETRY=y
	help
	  Enable intel_idle, a cpuidle driver that includes knowledge of
	  native Intel hardware idle features.  The acpi_idle driver
	  can be configured at the same time, in order to handle
	  processors intel_idle does not support.
```

## drivers/input/oneplus_touchscreen/Synaptics/Kconfig
```kconfig
source "drivers/input/oneplus_touchscreen/Synaptics/S3706/Kconfig"

config TOUCHPANEL_SYNAPTICS_TEST
    bool "Build Synaptics Auto-testing features"
    default n
    depends on TOUCHPANEL_SYNAPTICS
```

## drivers/oneplus/Kconfig
```kconfig
config OEM_BOOT_MODE
	bool "detect oem boot mode"
	default y
	help
          detect oem boot mode  If unsure, say y.
```

## drivers/oneplus/oneplus_healthinfo/Kconfig
```kconfig
config ONEPLUS_HEALTHINFO
	bool "config oneplus healthinfo"
	depends on ONEPLUS_FG_OPT
	default n
	help
	  define this config to init oneplus healthinfo.
config ONEPLUS_TASKLOAD_INFO
	bool "config oneplus healthinfo"
	depends on ONEPLUS_HEALTHINFO
	default y
	help
	  define this config to init oneplus taskload info.
```

## security/chromiumos/Kconfig
```kconfig
config SECURITY_CHROMIUMOS
	bool "Chromium OS Security Module"
	depends on SECURITY
	help
	  The purpose of the Chromium OS security module is to reduce attacking
	  surface by preventing access to general purpose access modes not
	  required by Chromium OS. Currently: the mount operation is
	  restricted by requiring a mount point path without symbolic links,
	  and loading modules is limited to only the root filesystem. This
	  LSM is stacked ahead of any primary "full" LSM.

config SECURITY_CHROMIUMOS_NO_SYMLINK_MOUNT
	bool "Chromium OS Security: prohibit mount to symlinked target"
	depends on SECURITY_CHROMIUMOS
	default y
	help
	  When enabled mount() syscall will return ELOOP whenever target path
	  contains any symlinks.

config SECURITY_CHROMIUMOS_DEVICE_JAIL
	bool "Chromium OS Security: device jail sandbox"
	depends on USB=y
	default y
	help
	  When enabled, the kernel device_jail interface will be enabled,
	  allowing further sandboxing of USB devices.

config ALT_SYSCALL_CHROMIUMOS
	bool "Chromium OS Alt-Syscall Tables"
	depends on ALT_SYSCALL
	help
	  Register restricted, alternate syscall tables used by Chromium OS
	  using the alt-syscall infrastructure.  Alternate syscall tables
	  can be selected with prctl(PR_ALT_SYSCALL).
```

## security/container/Kconfig
```kconfig
config SECURITY_CONTAINER_MONITOR
	bool "Monitor containerized processes"
	depends on SECURITY
	depends on VSOCKETS=y
	select SECURITYFS
	help
	  Instrument the Linux kernel to collect more information about containers
	  and identify security threats.

config SECURITY_CONTAINER_MONITOR_DEBUG
    bool "Enable debug pr_devel logs"
	depends on SECURITY_CONTAINER_MONITOR
	help
	  Define DEBUG for CSM files to compile verbose debugging messages.

	  Only for debugging/testing do not enable for production.

config SECURITY_CONTAINER_MONITOR_DEBUG_CONFIG
    bool "Allow user-mode to set collector configuration"
	depends on SECURITY_CONTAINER_MONITOR
	default n
	help
	  This configuration option adds a sysfs config file to test configuration
	  parsing without a fully enabled VMM backend.

	  Only for debugging/testing do not enable for production.
```
